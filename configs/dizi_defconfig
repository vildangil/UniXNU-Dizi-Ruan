## configs/dizi_defconfig
```kconfig
# Xiaomi Redmi Pad Pro (dizi), SM7435, iPadOS 17.7.11 bring-up kernel.
CONFIG_XNU_SOURCE_CORECRYPTO14=y
CONFIG_XNU_SOURCE_PTHREAD=y
CONFIG_XNU_ARM_DT_PLATFORM=y
CONFIG_XNU_ARMCPU=y
CONFIG_XNU_NATIVE_ARCH_TIMER=y
CONFIG_XNU_NATIVE_PAN=y
CONFIG_XNU_DT_PANIC_REGION=y
CONFIG_XNU_TRUST_CACHE_RUNTIME=y
CONFIG_XNU_NATIVE_CS_HASH_CACHE=y
CONFIG_XNU_CRYPTO_BOOTSTRAP="prelinked"
CONFIG_XNU_BUILD_ARCHIVES=y
# CONFIG_XNU_NATIVE_LEGACY_DISPLAY is not set
# CONFIG_XNU_SOURCE_MOCKFS is not set
# CONFIG_XNU_NATIVE_UFS is not set
# CONFIG_XNU_NATIVE_AES is not set
# CONFIG_XNU_NATIVE_RAM_BLOCK is not set
# CONFIG_XNU_NATIVE_MOBILE_DISPLAY is not set
# CONFIG_XNU_NATIVE_ADRENO is not set
# CONFIG_XNU_NATIVE_VIRTIO_BLOCK is not set
# CONFIG_XNU_NATIVE_VIRTIO_CONSOLE is not set
# CONFIG_XNU_SHENG_PMGR is not set
# CONFIG_XNU_ARMVIRT_PLATFORM is not set
# CONFIG_XNU_BOOT_PROGRESS is not set
```
